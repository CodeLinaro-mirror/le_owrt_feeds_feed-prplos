## net_services/plugins/tr181-zram/Config.in
```kconfig
config PACKAGE_tr181-zram
    tristate
    select SAH_AMX_TR181_ZRAM

if PACKAGE_tr181-zram

menu "Select tr181-zram build options"
    depends on PACKAGE_tr181-zram

config SAH_AMX_TR181_ZRAM
    bool "Build the tr181 swap and ZRAM plugin"
    default y
    select BUSYBOX_CONFIG_MKSWAP

config SAH_AMX_TR181_ZRAM_ORDER
    int "Start up order for the tr181 ZRAM plugin"
    default 13
	help
	  Must be after sysctl (11), whose vm.swappiness the plugin overrides.

config SAH_AMX_TR181_ZRAM_KMOD_LZ4
    bool "Install the LZ4 kernel module"
    default y
	help
	  LZ4 is the default of Swap.ZRAM.{i}.CompressionAlgorithm. Without the
	  module, a device that uses LZ4 falls back to the kernel default.

config SAH_AMX_TR181_ZRAM_KMOD_ZSTD
    bool "Install the ZSTD kernel module"
    default y
	help
	  Makes ZSTD available to Swap.ZRAM.{i}.CompressionAlgorithm.

endmenu

endif
```
