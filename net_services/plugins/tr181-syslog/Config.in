## swupdate/apps/swupdate/Config.in
```kconfig
config OPENSOURCE_SWUPDATE
    bool "build OPENSOURCE_SWUPDATE component"
    default y
config CONFIG_SWUPDATE_MTD
    bool "build OPENSOURCE_SWUPDATE component"
    default n
config OPENSOURCE_SWUPDATE_HWREVISION
    string "swupdate hwrevision file"
    depends on OPENSOURCE_SWUPDATE
    default "/tmp/hwrevision"
config OPENSOURCE_SWUPDATE_SWVERSIONS
    string "swupdate sw-versions file"
    depends on OPENSOURCE_SWUPDATE
    default "/tmp/sw-versions"
config OPENSOURCE_SWUPDATE_HANDLER_UBI
    bool "enable UBI volumes update support"
    default n
config OPENSOURCE_SURICATTA
    bool "enable suricatta"
    default y
config OPENSOURCE_SURICATTA_SSL
    bool "enable suricatta ssl"
    depends on OPENSOURCE_SURICATTA
    default y
config OPENSOURCE_SURICATTA_HAWKBIT
    bool "enable suricatta hawkbit"
    depends on OPENSOURCE_SURICATTA
    default y
config OPENSOURCE_SURICATTA_LUA
    bool "enable suricatta Lua"
    depends on OPENSOURCE_SURICATTA
    default n
config OPENSOURCE_EMBEDDED_SURICATTA_LUA
    bool "Embed Suricatta Lua module in SWUpdate binary"
    depends on OPENSOURCE_SURICATTA_LUA
    default n
config OPENSOURCE_EMBEDDED_SURICATTA_LUA_SOURCE
    string "Suricatta Lua module file"
    depends on OPENSOURCE_EMBEDDED_SURICATTA_LUA
    default "swupdate_suricatta.lua"
config OPENSOURCE_SWUPDATE_WEBSERVER
    bool "enable webserver support"
    default n
config OPENSOURCE_SWUPDATE_MONGOOSE
    bool "choose mongoose as webserver"
    depends on OPENSOURCE_SWUPDATE_WEBSERVER
    default y
config OPENSOURCE_SWUPDATE_MONGOOSEIPV6
    bool "enable ipv6 support on mongoose (dependancy not supported)"
    depends on OPENSOURCE_SWUPDATE_MONGOOSE
    default n
config OPENSOURCE_SWUPDATE_MONGOOSESSL
    bool "enable ssl support on mongoose (dependancy not supported)"
    depends on OPENSOURCE_SWUPDATE_MONGOOSE
    default n
config OPENSOURCE_SWUPDATE_INSTALL_WEB_EXAMPLE
    bool "install web example"
    depends on OPENSOURCE_SWUPDATE_MONGOOSE
    default n
config OPENSOURCE_SWUPDATE_RELEASE_WEB_EXAMPLE
    bool "release web example"
    depends on OPENSOURCE_SWUPDATE_INSTALL_WEB_EXAMPLE
    default y
    help
      Release web server example to rootfs during release step.
      If disabled, web server example sources will remain in staging only.
config OPENSOURCE_SWUPDATE_INSTALL_WEB_EXAMPLE_PATH
    string "path of the web example on the target"
    depends on OPENSOURCE_SWUPDATE_INSTALL_WEB_EXAMPLE
    default ""


config OPENSOURCE_SWUPDATE_UBOOT
    bool "Bootloader Interfaces U-Boot"
    depends on PACKAGE_libubootenv
    help
      Support for U-Boot
    default n
config OPENSOURCE_SWUPDATE_UBOOT_FWENV
    string "U-Boot Environment Configuration file"
    depends on OPENSOURCE_SWUPDATE_UBOOT
    help
	  This is the file described in U-Boot documentation
	  in the tools directory. It tells where the U-Boot
	  environment is saved.
    default "/etc/fw_env.config"
config OPENSOURCE_SWUPDATE_UBOOT_DEFAULTENV
    string "U-Boot Initial Environment file"
    depends on OPENSOURCE_SWUPDATE_UBOOT
    help
	  This is the file with the initial environment delivered
	  with the bootloader. It is used by SWUpdate if no environment
	  is found on the storage.
    default "/etc/u-boot-initial-env"
config OPENSOURCE_SWUPDATE_DISKFORMAT_HANDLER
    bool "diskformat handler for creating file systems"
    default n
config OPENSOURCE_SWUPDATE_EXT_FILESYSTEM
    bool "EXT2 / EXT3 / EXT4 file system creation support"
    depends on OPENSOURCE_SWUPDATE_DISKFORMAT_HANDLER
    select PACKAGE_libext2fs
    help
      Enable support for creating EXT file systems
    default n
config OPENSOURCE_SWUPDATE_DISKPART_HANDLER
	bool "enable diskpart update support"
	select PACKAGE_libfdisk
	default n
config OPENSOURCE_SWUPDATE_FAT_FILESYSTEM
    bool "FAT file system creation support"
    depends on OPENSOURCE_SWUPDATE_DISKFORMAT_HANDLER
    help
      Enable support for creating FAT file systems
    default n
```

## swupdate/kmods/sysregister/Config.in
```kconfig
config SYSREGISTER_RESET_BOOTCOUNT
	bool "Reset the bootcount at boot"
	default n
	help
	  Install an init script that resets the bootcount and disables the
	  temporary failover at the end of the boot sequence.
```

## swupdate/libs/libswu/Config.in
```kconfig
config PACKAGE_libswu
    tristate
    select SAH_LIB_SWU

if PACKAGE_libswu

menu "Select libswu build options"
    depends on PACKAGE_libswu

config SAH_LIB_SWU
    bool "Build libswu library"
    default y
	help
	  Library to hide board-specific aspects related to SW upgrade

choice
    prompt "storage type"
    default SAH_LIB_SWU_UBI

config SAH_LIB_SWU_UBI
    bool "ubi"

config SAH_LIB_SWU_VFLASH
    bool "vflash (BCM flash abstraction layer)"

config SAH_LIB_SWU_GPT
    bool "GPT"

endchoice

config SAH_LIB_SWU_UBI_DEVICE_NUMBER
    int "UBI device number"
    default 0
	help
	  UBI device with UBI volumes to upgrade.

config SAH_LIB_SWU_TOOLS
    bool "Build the debug tool libswu-tool"
    default n
	help
	  Say Y if you want to build and install the libswu-tool to debug this library. If unsure, say N.

config SAH_LIB_SWU_PREVIOUS_STAGE_NAME
    string "U-boot previous stage name"
    default "U-boot-prestage"
	help
	  lib_swu parses the sah-mailbox for a flag named uboot-prestage-version. If this flag is found, the value is added to sw-versions file. The matching image name in the sw-versions file is this configuration option value.

config SAH_LIB_SWU_SWUPDATE_PUBKEY
    string "SWUpdate public key path"
    default "/security/sbl/public.pem"

config SAH_LIB_SWU_SWUPDATE_MIN_VERSION
    string "Update file minimum version"
    default ""
	help
	  Setting this option will enable SWUpdate '-N' command line flag, specifying a minimum version. If the .swu file version (specified in header) is strictly lower, upgrade will be denied. Use this option with care, when you definitely want to forbid downgrade under a specific version.

choice
    prompt "Dual-bank scheme"
    default SAH_LIB_SWU_DUAL_BANK_SBL
	help
	  There are multiple schemes for partitioning and boot loader control of dual-bank upgrades and booting. lib_swu must be configured to support the scheme used on the target platform.
	  Select "SoftAtHome SBL" for SoftAtHome's own Secure Bootloader scheme.
	  Select "Broadcom BSP 5.04+" for the scheme supported by Broadcom U-Boot in BSP 5.04 onward.

config SAH_LIB_SWU_DUAL_BANK_SBL
    bool "SoftAtHome SBL"

config SAH_LIB_SWU_DUAL_BANK_BCM504
    bool "Broadcom BSP 5.04+"

endchoice

choice
    prompt "select flash layout format"
    default SAH_LIB_SWU_FLASH_LAYOUT_SOP
	help
	  lib_swu must select the flash layout format used on the target platform.

config SAH_LIB_SWU_FLASH_LAYOUT_SOP
    bool "SAH SOP flash layout"

config SAH_LIB_SWU_FLASH_LAYOUT_PRPL
    bool "PRPL flash layout"

endchoice

endmenu

endif
```

## swupdate/libs/libubootenv/Config.in
```kconfig
# Copyright (C) 2024 OpenWrt
#
# Kconfig entries for libubootenv and fw-printenv.

menu "Libraries"

config PACKAGE_libubootenv
	bool "libubootenv - Library to access U-Boot environment variables"
	default n
	help
	  libubootenv provides a hardware-independent API to access the
	  U-Boot environment (configuration variables stored by U-Boot).
	  Select this if you need the library directly or if another
	  package depends on it.

endmenu

menu "Utilities"

config PACKAGE_fw-printenv
	bool "fw_printenv / fw_setenv - U-Boot environment tools"
	default n
	select PACKAGE_libubootenv
	help
	  Command-line tools to read and modify U-Boot environment variables.
	  Includes:
	    * fw_printenv — print environment variables
	    * fw_setenv  — set environment variables

endmenu
```

## swupdate/mods/mod-fwi-swupdate/Config.in
```kconfig
config PACKAGE_mod-fwi-swupdate
    tristate
    select SAH_MOD_FWI_SWUPDATE

if PACKAGE_mod-fwi-swupdate

menu "Select mod-fwi-swupdate build options"
    depends on PACKAGE_mod-fwi-swupdate

config SAH_MOD_FWI_SWUPDATE
    bool "Enable firmware upgrade for swupdate"
    default y

config FWI_FLASH_PARTITIONS
    string "Partitions swapped during firmware activation"
    default "u-boot,kernel,rootfs"

config SWUPDATE_TARGET_HW_VERSION
    string "Hardware version name passed to swupdate"
    default "invalid:1.0"

endmenu

endif
```

## tr-069/plugins/tr069-discovery/Config.in
```kconfig
config PACKAGE_tr069-discovery
    tristate

if PACKAGE_tr069-discovery

menu "Select tr069-discovery build options"
    depends on PACKAGE_tr069-discovery

config TR069_DISCOVERY_ORDER
    int "ACS Discovery start up order"
    default 98

endmenu

endif
```

## usp/apps/usp_discovery/Config.in
```kconfig
menu "Select usp_discovery build options"
    depends on PACKAGE_usp_discovery

config DMM_USP_DISCOVERY_ORDER
    int "Start up order usp_discovery plugin"
    default 54

config USP_DISCOVERY_SUPPORT_MQTT_MTP
    bool "Whether MQTT MTP is supported for USP Controller discovery"
    default n

config USP_DISCOVERY_SUPPORT_STOMP_MTP
    bool "Whether STOMP MTP is supported for USP Controller discovery"
    default n

if USP_DISCOVERY_SUPPORT_MQTT_MTP
config USP_DISCOVERY_MQTT_AGENT_REPLY_TOPIC
    string "MQTT reply topic for DHCP-configured controller for the obuspa"
    default "/usp/controller"

config USP_DISCOVERY_MQTT_CONTROLLER_RESPONSE_TOPIC
    string "MQTT subscribe topic for DHCP-configured controller for the obuspa"
    default ""

endif

if USP_DISCOVERY_SUPPORT_STOMP_MTP

config USP_DISCOVERY_STOMP_AGENT_CONTROLLER_DST
    string "STOMP USP Controller destination, that will be used with a for DHCP-configured controller in obuspa"
    default "/usp/controller"

config USP_DISCOVERY_STOMP_CONTROLLER_AGENT_DST
    string "STOMP USP Agent destination, that will be used with a for DHCP-configured controller in obuspa"
    default ""

config USP_DISCOVERY_STOMP_FORCE_NO_ENCRYPTION
    bool "Whether encryption is disabled for STOMP protocol"
    default n
endif

endmenu
```
