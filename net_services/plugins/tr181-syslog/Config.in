## net_services/plugins/tr181-syslog/Config.in
```kconfig
config PACKAGE_tr181-syslog
    tristate
    select SAH_AMX_TR181_SYSLOG

if PACKAGE_tr181-syslog

menu "Select tr181-syslog build options"
    depends on PACKAGE_tr181-syslog

config SAH_AMX_TR181_SYSLOG
    bool "TR-181 compatible syslog"
    default y

config SAH_AMX_TR181_SYSLOG_ORDER
    int "TR-181 syslog plugin start up order"
    default 12

endmenu

endif
```

## net_services/plugins/tr181-temperature/Config.in
```kconfig
config PACKAGE_tr181-temperature
    tristate
    select SAH_AMX_TR181_TEMPERATURE

if PACKAGE_tr181-temperature

menu "Select tr181-temperature build options"
    depends on PACKAGE_tr181-temperature

config SAH_AMX_TR181_TEMPERATURE
    bool "Build a tr181 compatible temperature manager"
    default y

config SAH_AMX_TR181_TEMPERATURE_ORDER
    int "Start up order"
    default 15

config SAH_AMX_TR181_TEMPERATURE_RUN_AS_USER
    string "User will be used for the tr181-temperature plugin"
    default "tr181_app"

config SAH_AMX_TR181_TEMPERATURE_RUN_AS_GROUP
    string "Group will be used for the tr181-temperature plugin"
    default "tr181_app"

endmenu

endif
```

## net_services/plugins/tr181-tuntap/Config.in
```kconfig
config PACKAGE_tr181-tuntap
    tristate
    select SAH_AMX_TR181_TUNTAP

if PACKAGE_tr181-tuntap

menu "Select tr181-tuntap build options"
    depends on PACKAGE_tr181-tuntap

config SAH_AMX_TR181_TUNTAP
    bool "Build a tr181 compatible tuntap manager"
    default y

config SAH_AMX_TR181_TUNTAP_START_ORDER
    int "tr181 tuntap plugin start up order"
    default 82

config SAH_AMX_TR181_TUNTAP_STOP_ORDER
    int "tr181 tuntap plugin shutdown order"
    default 18

endmenu

endif
```

## net_services/plugins/tr181-upnp/Config.in
```kconfig
config PACKAGE_tr181-upnp
    tristate
    select SAH_AMX_TR181_UPNP

if PACKAGE_tr181-upnp

menu "Select tr181-upnp build options"
    depends on PACKAGE_tr181-upnp

config SAH_AMX_TR181_UPNP
    bool "Build a tr181 compatible upnp manager"
    default y

config SAH_AMX_TR181_UPNP_ORDER
    int "Start up order for the tr181 upnp manager"
    default 80

config SAH_AMX_TR181_UPNP_RUN_AS_USER
    string "User will be used for the tr181-upnp plugin"
    default "tr181_app"

config SAH_AMX_TR181_UPNP_RUN_AS_GROUP
    string "Group will be used for the tr181-upnp plugin"
    default "tr181_app"

config SAH_AMX_TR181_UPNP_MOD_UPNPADVERTISE_LIBUPNP
    bool "Build the upnp advertise module for tr181-upnp using libupnp"
    default y

endmenu

endif
```

## net_services/plugins/tr181-upnpdiscovery/Config.in
```kconfig
config PACKAGE_tr181-upnpdiscovery
    tristate
    select SAH_AMX_TR181_UPNPDISCOVERY

if PACKAGE_tr181-upnpdiscovery

menu "Select tr181-upnpdiscovery build options"
    depends on PACKAGE_tr181-upnpdiscovery

config SAH_AMX_TR181_UPNPDISCOVERY
    bool "Build a tr181 compatible upnp discovery manager"
    default y

config SAH_AMX_TR181_UPNPDISCOVERY_START_ORDER
    int "Start up order for the tr181 upnp discovery manager"
    default 80

config SAH_AMX_TR181_UPNPDISCOVERY_STOP_ORDER
    int "Shutdown for the tr181 upnp discovery manager"
    default 20

config SAH_AMX_TR181_UPNPDISCOVERY_RUN_AS_USER
    string "User will be used for the tr181-upnpdiscovery plugin"
    default "tr181_app"

config SAH_AMX_TR181_UPNPDISCOVERY_RUN_AS_GROUP
    string "Group will be used for the tr181-upnpdiscovery plugin"
    default "tr181_app"

endmenu

endif
```

## net_services/plugins/tr181-wireguard/Config.in
```kconfig
config PACKAGE_tr181-wireguard
    tristate
    select SAH_AMX_TR181_WIREGUARD

if PACKAGE_tr181-wireguard

menu "Select tr181-wireguard build options"
    depends on PACKAGE_tr181-wireguard

config SAH_AMX_TR181_WIREGUARD
    bool "Build a tr181 compatible WireGuard plugin"
    default y

config SAH_AMX_TR181_WIREGUARD_START_ORDER
    int "Start up order for the tr181 WireGuard plugin"
    default 25

config SAH_AMX_TR181_WIREGUARD_STOP_ORDER
    int "Shutdown order for the tr181 WireGuard plugin"
    default 75

endmenu

endif
```

## netmodel/libs/libnemo-client/Config.in
```kconfig
config PACKAGE_libnemo-client
    tristate
    select SAH_LIB_NEMO-CLIENT

if PACKAGE_libnemo-client

menu "Select libnemo-client build options"
    depends on PACKAGE_libnemo-client

config SAH_LIB_NEMO-CLIENT
    bool "Build NeMo client library"
    default y

config SAH_LIB_NEMO-CLIENT_AMX_COMP
    bool "Build the Nemo library for AMX compatible system"
    default n

endmenu

endif
```

## openwrt/packages/net/miniupnpd/Config.in
```kconfig
choice
    prompt "Firewall controller"
    default MINIUPNP_IPTABLES

config MINIUPNP_IPTABLES
    bool "Use iptables as firewall"

config MINIUPNP_TR181-FIREWALL
    bool "Use tr181-firewall as firewall"
endchoice
```

## peripheral/plugins/reboot-service/Config.in
```kconfig
config PACKAGE_reboot-service
    tristate
    select SAH_REBOOT_SERVICE

if PACKAGE_reboot-service

menu "Select reboot-service build options"
    depends on PACKAGE_reboot-service

config SAH_REBOOT_SERVICE
    bool "Build reboot plug-in"
    default y

config SAH_REBOOT_SERVICE_START_ORDER
    int "Reboot service start up order"
    default 18

config SAH_REBOOT_SERVICE_STOP_ORDER
    int "Reboot service shutdown order"
    default 82

config SAH_REBOOT_SERVICE_RUN_AS_USER
    string "User will be used for the reboot-service plugin"
    default "tr181_app"

config SAH_REBOOT_SERVICE_RUN_AS_GROUP
    string "Group will be used for the reboot-service plugin"
    default "tr181_app"

endmenu

endif
```

## peripheral/plugins/tr181-button/Config.in
```kconfig
config PACKAGE_tr181-button
    tristate
    select SAH_AMX_TR181_BUTTON

if PACKAGE_tr181-button

menu "Select tr181-button build options"
    depends on PACKAGE_tr181-button

config SAH_AMX_TR181_BUTTON
    bool "TR-181 Device.X_PRPLWARE-COM_Buttons datamodel implementation"
    default y

config SAH_AMX_TR181_BUTTON_RUN_AS_USER
    string "User will be used for the tr181-button plugin"
    default "tr181_app"

config SAH_AMX_TR181_BUTTON_RUN_AS_GROUP
    string "Group will be used for the tr181-button plugin"
    default "tr181_app"

config SAH_AMX_TR181_BUTTON_START_ORDER
    int "Start up order for the tr181 button plugin"
    default 40

config SAH_AMX_TR181_BUTTON_STOP_ORDER
    int "Shutdown order for the tr181 button plugin"
    default 60

endmenu

endif
```

## peripheral/plugins/tr181-led/Config.in
```kconfig
config PACKAGE_tr181-led
    tristate
    select SAH_AMX_TR181_LED

if PACKAGE_tr181-led

menu "Select tr181-led build options"
    depends on PACKAGE_tr181-led

config SAH_AMX_TR181_LED
    bool "Build a tr181 compatible leds manager"
    default y

config SAH_AMX_TR181_LED_ORDER
    int "Start up order"
    default 15

config SAH_AMX_TR181_LED_RUN_AS_USER
    string "User will be used for the tr181-led plugin"
    default "tr181_app"

config SAH_AMX_TR181_LED_RUN_AS_GROUP
    string "Group will be used for the tr181-led plugin"
    default "tr181_app"

endmenu

endif
```

## prplos/network/plugins/tr181-captiveportal/Config.in
```kconfig
config PACKAGE_tr181-captiveportal
    tristate
    select SAH_AMX_TR181_CAPTIVEPORTAL

if PACKAGE_tr181-captiveportal

menu "Select tr181-captiveportal build options"
    depends on PACKAGE_tr181-captiveportal

config SAH_AMX_TR181_CAPTIVEPORTAL
    bool "Build the AMX Captive Portal plugin"
    default y

config SAH_AMX_TR181_CAPTIVEPORTAL_EXAMPLE
    bool "Install the example captive portal page"
    default y

endmenu

endif
```

## prplos/network/plugins/tr181-device/Config.in
```kconfig
config PACKAGE_tr181-device
    tristate
    select SAH_AMX_TR181_DEVICE

if PACKAGE_tr181-device

menu "Select tr181-device build options"
    depends on PACKAGE_tr181-device

config SAH_AMX_TR181_DEVICE
    bool "Build a tr181 compatible device plugin"
    default y

config SAH_AMX_TR181_DEVICE_ORDER
    int "Start up order for the tr181 device plugin"
    default 41

config SAH_AMX_TR181_DEVICE_RESET_HARD_ENABLE
    bool "Custom using FactoryReset() rpc call reset_hard or firstboot -y"
    default y

config SAH_AMX_TR181_DEVICE_OBUSPA_SUPPORT
    bool "Enable OBUSPA support"
    default n

endmenu

endif
```

## prplos/prpl-configuration/Config.in
```kconfig
config PACKAGE_prpl-configuration
    tristate
    select PRPL_CONFIG

if PACKAGE_prpl-configuration

choice
	bool "Build Mode Configuration"
	default PRPL_CPE_OPMODE_GATEWAY

config PRPL_CPE_OPMODE_GATEWAY
        bool
        prompt "Build Software as a Gateway"

config PRPL_CPE_OPMODE_EXTENDER
	bool
	prompt "Build Software as an Extender"

endchoice

config PRPL_CPE_OPMODE
	string
	default "gateway" if PRPL_CPE_OPMODE_GATEWAY
	default "extender" if PRPL_CPE_OPMODE_EXTENDER

endif
```

## qos_firewall/libs/libfwinterface/Config.in
```kconfig
config PACKAGE_libfwinterface
    tristate
    select SAH_LIB_FWINTERFACE

if PACKAGE_libfwinterface

menu "Select libfwinterface build options"
    depends on PACKAGE_libfwinterface

config SAH_LIB_FWINTERFACE
    bool "Build the firewall interfaces library"
    default n
    depends on SAH_LIB_FWRULES

choice
    prompt "Choose the interface to use between lib_fwrules and netfilter"
    default SAH_LIB_FWINTERFACE_INTERFACE_IPTC

config SAH_LIB_FWINTERFACE_INTERFACE_DUMMY
    bool "Dummy interface. Does nothing"

config SAH_LIB_FWINTERFACE_INTERFACE_IPTC
    bool "Use lib_iptc as the interface"

endchoice

config SAH_LIB_FWINTERFACE_SUPPORTS_PHYSDEV
    bool "Build with iptables-mod-physdev support"
    default y
    depends on SAH_LIB_FWINTERFACE_INTERFACE_IPTC

config SAH_LIB_FWINTERFACE_DEFAULT_LOCKFILE
    string "Default value for the lockfile"
    default "/var/run/xtables.lock"
    depends on !SAH_LIB_FWINTERFACE_LOCKFILE_PER_TABLE

config SAH_LIB_FWINTERFACE_LOCKFILE_PER_TABLE
    bool "Use a lockfile per table (and IP version). WARNING: iptables should be patched to support the same lockfiles to avoid conflicts. WARNING: risk of deadlocking? The following lockfiles will be used for IPv6: /var/run/ip6tables.lock_mangle /var/run/ip6tables.lock_filter /var/run/ip6tables.lock_raw /var/run/ip6tables.lock_nat The following lockfiles will be used for IPv4: /var/run/iptables.lock_mangle /var/run/iptables.lock_filter /var/run/iptables.lock_raw /var/run/iptables.lock_nat"
    default n

endmenu

endif
```

## qos_firewall/plugins/packet-interception/Config.in
```kconfig
config PACKAGE_packet-interception
    tristate
    select SAH_AMX_PACKET_INTERCEPTION

if PACKAGE_packet-interception

menu "Select packet-interception build options"
    depends on PACKAGE_packet-interception

config SAH_AMX_PACKET_INTERCEPTION
    bool "Build a packet interception component"
    default y

config SAH_AMX_PACKET_INTERCEPTION_ORDER
    int "Start up order"
    default 50

config SAH_AMX_PACKET_INTERCEPTION_TR181_FIREWALL_RULEPATH
    string "Firewall iptables rules folder location"
    default "/etc/amx/tr181-firewall"

config SAH_AMX_PACKET_INTERCEPTION_SUPPORT_SKIPLOG
    bool "Support skiplog"
    default n

endmenu

endif
```

## qos_firewall/plugins/tr181-firewall/Config.in
```kconfig
config PACKAGE_tr181-firewall
    tristate
    select SAH_AMX_TR181_FIREWALL

if PACKAGE_tr181-firewall

menu "Select tr181-firewall build options"
    depends on PACKAGE_tr181-firewall

config SAH_AMX_TR181_FIREWALL
    bool "Build a tr181 compatible firewall manager"
    default y

config SAH_AMX_TR181_FIREWALL_ORDER
    int "Start up order"
    default 22

config SAH_AMX_TR181_FIREWALL_RUN_AS_USER
    string "User will be used for the tr181-firewall plugin"
    default "tr181_app"

config SAH_AMX_TR181_FIREWALL_RUN_AS_GROUP
    string "Group will be used for the tr181-firewall plugin"
    default "tr181_app"

config SAH_AMX_TR181_FIREWALL_WITH_GMAP
    bool "Compile tr181-firewall with gmap to support hostname translation."
    default y

config SAH_AMX_TR181_FIREWALL_LOGS
    bool "[DEPRECATED, now always true] Compile tr181-firewall with netfilter log support. The logs might affect performance."
    default y

config SAH_AMX_TR181_FIREWALL_DEBUG_PROFILING
    bool "Compile tr181-firewall with profiling logs."
    default n

config SAH_AMX_TR181_FIREWALL_PORTMAPPING_CONNTRACK_INACTIVITY_CHECK
    bool "Compile tr181-firewall with portmapping inactivity check using conntrack."
    default n

config PRPL_CPE_OPMODE_EXTENDER
    bool ""
    default n

config PRPL_CPE_OPMODE_GATEWAY
    bool ""
    default y

endmenu

endif
```

## rdkcentral/json-hal-library/Config.in
```kconfig
config PACKAGE_json-hal-library
    tristate
    select SAH_JSON_HAL_LIBRARY

if PACKAGE_json-hal-library

menu "Select json-hal-library build options"
    depends on PACKAGE_json-hal-library

config SAH_JSON_HAL_LIBRARY
    bool "Build json-hal-library"
    default y

config SAH_JSON_HAL_LIBRARY_DISABLE_SCHEMA_VALIDATION
    bool "Disable schema validation for json-hal-library"
    default y

config SAH_JSON_HAL_LIBRARY_DISABLE_BLOCKING_SUBSCRIBE_EVENT
    bool "Disable blocking subscribe event for json-hal-library"
    default y

endmenu

endif
```
