## usp/libs/libusp/Config.in
```kconfig
config PACKAGE_libusp
    tristate
    select SAH_LIB_USP

if PACKAGE_libusp

menu "Select libusp build options"
    depends on PACKAGE_libusp

config SAH_LIB_USP
    bool "Build the usp translation library"
    default y

endmenu

endif
```

## usp/libs/libuspprotobuf/Config.in
```kconfig
config PACKAGE_libuspprotobuf
    tristate
    select SAH_LIB_USP_PROTOBUF

if PACKAGE_libuspprotobuf

menu "Select libuspprotobuf build options"
    depends on PACKAGE_libuspprotobuf

config SAH_LIB_USP_PROTOBUF
    bool "Generate C code for creating USP protobuf messages and records"
    default y

endmenu

endif
```

## usp/mods/mod-amxb-usp/Config.in
```kconfig
config PACKAGE_mod-amxb-usp
    tristate
    select SAH_MOD_AMXB_USP

if PACKAGE_mod-amxb-usp

menu "Select mod-amxb-usp build options"
    depends on PACKAGE_mod-amxb-usp

config SAH_MOD_AMXB_USP
    bool "Build the USP backend for ambiorix"
    default y

config SAH_MOD_AMXB_USP_INSTALL_DIR
    string "Installation directory for the USP backend"
    default "/usr/bin/mods/usp"

endmenu

endif
```
