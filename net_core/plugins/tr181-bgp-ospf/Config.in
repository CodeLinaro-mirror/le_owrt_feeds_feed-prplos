## net_core/plugins/tr181-bgp-ospf/Config.in
```kconfig
menu "Select tr181-bgp-ospf build options"
    depends on PACKAGE_tr181-bgp-ospf

config TR181_BGP_OSPF_START_ORDER
    int "tr181-bgp-ospf start up order"
    default 99

config TR181_BGP_OSPF_STOP_ORDER
    int "tr181-bgp-ospf stop order"
    default 0

config TR181_BGP_OSPF_RUN_AS_USER
    string "User the tr181-bgp-ospf plugin runs as"
    default "tr181_app"

config TR181_BGP_OSPF_RUN_AS_GROUP
    string "Group the tr181-bgp-ospf plugin runs as"
    default "tr181_app"

endmenu
```

## net_core/plugins/tr181-bridging/Config.in
```kconfig
config PACKAGE_tr181-bridging
    tristate
    select SAH_AMX_TR181_BRIDGING

if PACKAGE_tr181-bridging

menu "Select tr181-bridging build options"
    depends on PACKAGE_tr181-bridging

config SAH_AMX_TR181_BRIDGING
    bool "Build the TR-181 compatible bridging manager"
    default y

config SAH_AMX_TR181_BRIDGING_RUN_AS_USER
    string "User will be used for the bridging manager plugin"
    default "tr181_app"

config SAH_AMX_TR181_BRIDGING_RUN_AS_GROUP
    string "Group will be used for the bridging manager plugin"
    default "tr181_app"

config SAH_AMX_TR181_BRIDGING_START_ORDER
    int "Init start up order for the bridging manager plugin"
    default 22

config SAH_AMX_TR181_BRIDGING_STOP_ORDER
    int "Init stop order for the bridging manager plugin"
    default 76

config SAH_AMX_TR181_BRIDGING_ENABLE_STP_FOR_LAN_BRIDGE
    bool "Enable spanning tree on the LAN bridge by default"
    default n
    help
        Off keeps the schema default, STP disabled.

endmenu

endif
```

## net_core/plugins/tr181-radsecproxy/Config.in
```kconfig
config PACKAGE_tr181-radsecproxy
    tristate
    select SAH_AMX_TR181_RADSECPROXY

if PACKAGE_tr181-radsecproxy

menu "Select tr181-radsecproxy build options"

    depends on PACKAGE_tr181-radsecproxy

config SAH_AMX_TR181_RADSECPROXY
    bool "Build a tr181-radsecproxy plugin"
    default y

config SAH_AMX_TR181_RADSECPROXY_ORDER
    int "Start up order for the tr181-radsecproxy plugin"
    default 25

config SAH_AMX_TR181_RADSECPROXY_RUN_AS_USER
    string "User will be used for the tr181-radsecproxy plugin"
    default "tr181_app"

config SAH_AMX_TR181_RADSECPROXY_RUN_AS_GROUP
    string "Group will be used for the tr181-radsecproxy plugin"
    default "tr181_app"

endmenu
endif
```

## net_core/plugins/tr181-vrrp/Config.in
```kconfig
config TR181_VRRP_INSTALL_ACTION_SCRIPT_WIFI
    bool "Install default WiFi action scripts"
    depends on PACKAGE_tr181-vrrp
    depends on PACKAGE_prplmesh-process-manager
    default y
    help
      Install optional VRRP action scripts for controlling PWHM, PrplMesh
      and Sensing through the process manager data model. No action group
      is configured automatically.

config TR181_VRRP_INSTALL_ACTION_SCRIPT_LAN6
    bool "Install default IPv6 LAN action scripts"
    depends on PACKAGE_tr181-vrrp
    depends on PACKAGE_ip-manager
    depends on PACKAGE_tr181-routeradvertisement
    depends on PACKAGE_dhcpv6s-manager
    default y
    help
      Install optional IPv6 LAN action scripts, the lan6 action group
      and startup monitors for the IP, RA and DHCPv6 server data models.
      Assign the action group to a virtual router manually.
```

## net_services/plugins/amx-processmonitor-watcher/Config.in
```kconfig
config PACKAGE_amx-processmonitor-watcher
    tristate
    select SAH_AMX_PROCESSMONITOR_WATCHER

if PACKAGE_amx-processmonitor-watcher

menu "Select amx-processmonitor-watcher build options"
    depends on PACKAGE_amx-processmonitor-watcher

config SAH_AMX_PROCESSMONITOR_WATCHER
    bool "Build amx-processmonitor-watcher plugin"
    default y

config SAH_AMX_PROCESSMONITOR_WATCHER_START_ORDER
    int "Start up order"
    default 99

config SAH_AMX_PROCESSMONITOR_WATCHER_STOP_ORDER
    int "Stop order"
    default 0

endmenu

endif
```

## net_services/plugins/tr181-bootstatus/Config.in
```kconfig
config PACKAGE_tr181-bootstatus
    tristate
    select SAH_AMX_TR181_BOOTSTATUS

if PACKAGE_tr181-bootstatus

menu "Select tr181-bootstatus build options"
    depends on PACKAGE_tr181-bootstatus

config SAH_AMX_TR181_BOOTSTATUS
    bool "Build the tr181-bootstatus device lifecycle/boot telemetry plugin"
    default y

config SAH_AMX_TR181_BOOTSTATUS_ORDER
    int "Start up order (early, so later stages are seen live; stages reached before it starts are back-dated)"
    default 10

config SAH_AMX_TR181_BOOTSTATUS_RUN_AS_USER
    string "User will be used for the tr181-bootstatus plugin"
    default "tr181_app"

config SAH_AMX_TR181_BOOTSTATUS_RUN_AS_GROUP
    string "Group will be used for the tr181-bootstatus plugin"
    default "tr181_app"

endmenu

endif
```

## prplos/prpl-securestore/Config.in
```kconfig
config PRPL_SFL_SECURESTORE_LABEL
	string
	prompt "Securestore partition label"
	default "securestore"
	help
	  The partition label used to identify the securestore partition.
	  The mnt-cfg preinit script will search for a partition with this
	  label to mount at /cfg.

config PRPL_SFL_SECURESTORE_FS_TYPE
	string
	prompt "Securestore partition filesystem type"
	default "ext4"
	help
	  The filesystem type of the securestore partition.
	  If needed, the mnt-cfg preinit script will format the securestore
	  partition.
```

## swupdate/utilities/imagegenerator/Config.in
```kconfig
config PACKAGE_imagegenerator
    tristate
    select IMAGEGENERATOR

if PACKAGE_imagegenerator

menu "Select imagegenerator build options"
    depends on PACKAGE_imagegenerator

config IMAGEGENERATOR
    bool "Build imagenerator"
    default y
	help
	  Component that provides tools to build various images formats

config IMAGEGENERATOR_BOARD
    string "Board to build images for"
    default ""
	help
	  The board name is used to retrieve config files and build images

endmenu

endif
```

## swupdate/utilities/initramfs-generator/Config.in
```kconfig
config PACKAGE_initramfs-generator
    tristate
    select INITRAMFS_GENERATOR

if PACKAGE_initramfs-generator

menu "Select initramfs-generator build options"
    depends on PACKAGE_initramfs-generator

config INITRAMFS_GENERATOR
    bool "Build initramfs-generator"
    default y
	help
	  Provide tools to build a pivoting initramfs.
    depends on (CONFIG_KERNEL_DEVTMPFS && CONFIG_BUSYBOX_CONFIG_MODPROBE && CONFIG_BUSYBOX_CONFIG_MODPROBE_SMALL && CONFIG_BUSYBOX_CONFIG_FEATURE_MODPROBE_SMALL_CHECK_ALREADY_LOADED && CONFIG_PACKAGE_kmod-dm && CONFIG_PACKAGE_blkid && CONFIG_PACKAGE_blockdev && CONFIG_PACKAGE_lvm2) || SAH_BOOTLOADER_INITRAMFS

config INITRAMFS_GENERATOR_DEBUG
    bool "debug mode"
    default n
	help
	  Debugging mode. Will enable more traces, and a fail during startup will drop
	  the user in a rescue shell instead of rebooting.

config INITRAMFS_GENERATOR_ROOTFS_SIG_PRELOAD
    bool "support rootfs pre-load signature"
    default y
	help
	  Support rootfs signature with U-boot pre-load method (see
	  https://github.com/u-boot/u-boot/blob/master/tools/binman/etype/pre_load.py).
    depends on (CONFIG_BUSYBOX_CONFIG_HEXDUMP && CONFIG_BUSYBOX_CONFIG_SHA256SUM && CONFIG_BUSYBOX_CONFIG_DD && CONFIG_PACKAGE_openssl-util) || SAH_BOOTLOADER_INITRAMFS

config INITRAMFS_GENERATOR_ROOTFS_SIG_PRELOAD_MANDATORY
    bool "make pre-load signature mandatory on rootfs FIT"
    default n
	help
	  With this option, rootfs SHOULD be signed with U-boot pre-load signature. If
	  the corresponding magic is not found, instead of skipping signature verification,
	  the boot will fail this image.
    depends on INITRAMFS_GENERATOR_ROOTFS_SIG_PRELOAD

endmenu

endif
```
