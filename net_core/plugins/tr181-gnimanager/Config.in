## net_core/plugins/tr181-gnimanager/Config.in
```kconfig
config PACKAGE_tr181-gnimanager
    tristate
    select SAH_AMX_TR181_GNIMANAGER

if PACKAGE_tr181-gnimanager

menu "Select tr181-gnimanager build options"
    depends on PACKAGE_tr181-gnimanager

config SAH_AMX_TR181_GNIMANAGER
    bool "Build a gni-manager plugin"
    default y

config SAH_AMX_TR181_GNIMANAGER_ORDER
    int "Start up order for the gni-manager plugin"
    default 25

config SAH_AMX_TR181_GNIMANAGER_RUN_AS_USER
    string "User will be used for the gni-manager plugin"
    default "tr181_app"

config SAH_AMX_TR181_GNIMANAGER_RUN_AS_GROUP
    string "Group will be used for the gni-manager plugin"
    default "tr181_app"

endmenu

endif
```

## net_core/plugins/tr181-lanconfigsecurity/Config.in
```kconfig
config PACKAGE_tr181-lanconfigsecurity
    tristate
    select SAH_AMX_TR181_LAN_CONFIG_SECURITY

if PACKAGE_tr181-lanconfigsecurity

menu "Select tr181-lanconfigsecurity build options"
    depends on PACKAGE_tr181-lanconfigsecurity

config SAH_AMX_TR181_LAN_CONFIG_SECURITY
    bool "Configuration plug-in to allow LAN access to protected auto-configuration services"
    default y

config SAH_AMX_TR181_LAN_CONFIG_SECURITY_START_ORDER
    int "Start up order for the LANConfigSecurity plugin"
    default 99

config SAH_AMX_TR181_LAN_CONFIG_SECURITY_STOP_ORDER
    string "Shutdown order for the LANConfigSecurity plugin"
    default "01"

endmenu

endif
```

## net_core/plugins/tr181-passthrough/Config.in
```kconfig
config PACKAGE_tr181-passthrough
        tristate
        select AMX_TR181-PASSTHROUGH
 
if PACKAGE_tr181-passthrough
 
menu "Select tr181-passthrough build options"
        depends on PACKAGE_tr181-passthrough
 
config AMX_TR181_PASSTHROUGH
        bool "TR-181 passthrough manager implementation"
        default y
 
config AMX_TR181_PASSTHROUGH_ORDER
        int "Startup order for passthrough-manager"
        default 96

config AMX_TR181_PASSTHROUGH_RUN_AS_USER
        string "User will be used for the passthrough-manager plugin"
        default "tr181_app"
 
config AMX_TR181_PASSTHROUGH_RUN_AS_GROUP
        string "Group will be used for the passthrough-manager plugin"
        default "tr181_app"
 
endmenu
 
endif
```

## net_core/plugins/tr181-routeradvertisement/Config.in
```kconfig
config PACKAGE_tr181-routeradvertisement
    tristate
    select SAH_SERVICES_AMX-TR181ROUTERADVERTISEMENT

if PACKAGE_tr181-routeradvertisement

menu "Select tr181-routeradvertisement build options"
    depends on PACKAGE_tr181-routeradvertisement

config SAH_SERVICES_AMX-TR181ROUTERADVERTISEMENT
    bool "TR-181 Device.RouterAdvertisement datamodel implementation"
    default y

config SAH_SERVICES_AMX-TR181ROUTERADVERTISEMENT_RUN_AS_USER
    string "User will be used for the tr181-routeradvertisement plugin"
    default "tr181_app"

config SAH_SERVICES_AMX-TR181ROUTERADVERTISEMENT_RUN_AS_GROUP
    string "Group will be used for the tr181-routeradvertisement plugin"
    default "tr181_app"

config SAH_SERVICES_AMX-TR181ROUTERADVERTISEMENT_START_ORDER
    int "Init start up order for the tr181-routeradvertisement plugin"
    default 40

config SAH_SERVICES_AMX-TR181ROUTERADVERTISEMENT_STOP_ORDER
    int "Init stop order for the tr181-routeradvertisement plugin"
    default 60

endmenu

endif
```

## net_core/plugins/tr181-sfp/Config.in
```kconfig
config PACKAGE_tr181-sfp
    tristate
    select SAH_AMX_TR181_SFP

if PACKAGE_tr181-sfp

menu "Select tr181-sfp build options"
    depends on PACKAGE_tr181-sfp

config SAH_AMX_TR181_SFP
    bool "Build a tr181 compatible time plugin"
    default y

config SAH_AMX_TR181_SFP_ORDER
    int "SFP manager plugin start up order"
    default 30

endmenu

endif
```

## net_core/plugins/tr181-usb/Config.in
```kconfig
config PACKAGE_tr181-usb
    tristate
    select AMX_TR181_USB

if PACKAGE_tr181-usb

menu "Select tr181-usb build options"
    depends on PACKAGE_tr181-usb

config AMX_TR181_USB
    bool "Build a TR-181 compatible USB manager"
    default y

config AMX_TR181_USB_ORDER
    int "Start up order for the tr181-usb manager"
    default 81

config AMX_TR181_USB_BUSYBOX_MDEV_OPTIONS
	bool "Enable busybox support for mdev device events"
	default n
	select BUSYBOX_CONFIG_MDEV
	select BUSYBOX_CONFIG_FEATURE_MDEV_CONF
	select BUSYBOX_CONFIG_FEATURE_MDEV_RENAME
	select BUSYBOX_CONFIG_FEATURE_MDEV_RENAME_REGEXP
	select BUSYBOX_CONFIG_FEATURE_MDEV_EXEC
	help
	  Select needed busybox options for usb device events.

endmenu

endif
```

## net_core/plugins/tr181-xpon/Config.in
```kconfig
config PACKAGE_tr181-xpon
    tristate
    select SAH_AMX_TR181_XPON

if PACKAGE_tr181-xpon

menu "Select tr181-xpon build options"
    depends on PACKAGE_tr181-xpon

config SAH_AMX_TR181_XPON
    bool "Build a TR-181 XPON manager"
    default y

config SAH_AMX_TR181_XPON_ORDER
    int "TR-181 XPON manager start up order"
    default 30

config SAH_AMX_TR181_XPON_MAX_ONUS
    int "Maximum number of ONUs"
    default 1

config SAH_AMX_TR181_XPON_USE_NETDEV_COUNTERS
    bool "Get counters from netdev"
    default n
	help
	  If not enabled the vendor module is responsible for displaying the network statistics in the tr181-xpon datamodel

config SAH_AMX_TR181_XPON_SUPPORT_PM_OBJECTS
    bool "Support Performance Monitoring (PM) objects"
    default n
	help
	  Say Y if tr181-xpon should support querying the parameters of the PM objects. The XPON DM always shows the PM objects, independent of the value of this option. If this option is not set, the parameters in the PM objects will stay 0. Set to Y if your config uses a PON vendor module which supports the PM objects. The default value of this option is no because several PON vendor modules do not yet support the PM objects.

endmenu

endif
```

## net_hl_services/plugins/hosts-manager/Config.in
```kconfig
config PACKAGE_hosts-manager
    tristate
    select SAH_SERVICES_AMX-HOSTS-MANAGER

if PACKAGE_hosts-manager

menu "Select hosts-manager build options"
    depends on PACKAGE_hosts-manager

config SAH_SERVICES_AMX-HOSTS-MANAGER
    bool "TR-181 Device.Hosts datamodel implementation"
    default y

config SAH_SERVICES_AMX-HOSTS-MANAGER_RUN_AS_USER
    string "User will be used for the hosts-manager plugin"
    default "tr181_app"

config SAH_SERVICES_AMX-HOSTS-MANAGER_RUN_AS_GROUP
    string "Group will be used for the hosts-manager plugin"
    default "tr181_app"

endmenu

endif
```

## net_hl_services/plugins/tr104-voip/Config.in
```kconfig
config PACKAGE_tr104-voip
    tristate
    select SAH_AMX_TR104_VOIP

if PACKAGE_tr104-voip

menu "Select tr104-voip build options"
    depends on PACKAGE_tr104-voip

config SAH_AMX_TR104_VOIP
    bool "Build the tr104 VoIP manager"
    default y

config SAH_AMX_TR104_VOIP_ORDER
    int "Set the tr104 VoIP manager start up order"
    default 99

endmenu

endif
```

## net_hl_services/plugins/tr181-captiveportal/Config.in
```kconfig
config PACKAGE_tr181-captiveportal
    tristate
    select SAH_AMX_TR181_CAPTIVEPORTAL

if PACKAGE_tr181-captiveportal

menu "Select tr181-captiveportal build options"
    depends on PACKAGE_tr181-captiveportal

config SAH_AMX_TR181_CAPTIVEPORTAL
    bool "Build the AMX Captive Portal plugin"
    default y

config SAH_AMX_TR181_CAPTIVEPORTAL_EXAMPLE
    bool "Install the example captive portal page"
    default y

config SAH_AMX_TR181_CAPTIVEPORTAL_START_ORDER
    int "Init start up order for the the AMX Captive Portal plugin"
    default 90

config SAH_AMX_TR181_CAPTIVEPORTAL_STOP_ORDER
    int "Init stop order for the AMX Captive Portal plugin"
    default 90

endmenu

endif
```

## net_hl_services/plugins/tr181-mqttbroker/Config.in
```kconfig
config PACKAGE_tr181-mqttbroker
    tristate
    select SAH_AMX_TR181_MQTTBROKER

if PACKAGE_tr181-mqttbroker

menu "Select tr181-mqttbroker build options"
    depends on PACKAGE_tr181-mqttbroker

config SAH_AMX_TR181_MQTTBROKER
    bool "TR-181 compatible MQTT broker"
    default y

config SAH_AMX_TR181_MQTTBROKER_ORDER
    int "TR-181 MQTT broker plugin start up order"
    default 49

config SAH_AMX_TR181_MQTTBROKER_RUN_AS_USER
    string "User that will be used for the tr181-mqttbroker plugin"
    default "tr181_app"

config SAH_AMX_TR181_MQTTBROKER_RUN_AS_GROUP
    string "Group that will be used for the tr181-mqttbroker plugin"
    default "tr181_app"

endmenu

endif
```

## net_hl_services/plugins/tr181-schedules/Config.in
```kconfig
config PACKAGE_tr181-schedules
    tristate
    select SAH_AMX_TR181_SCHEDULES

if PACKAGE_tr181-schedules

menu "Select tr181-schedules build options"
    depends on PACKAGE_tr181-schedules

config SAH_AMX_TR181_SCHEDULES
    bool "Build TR-181 Schedules plugin"
    default y

config SAH_AMX_TR181_SCHEDULES_RUN_AS_USER
    string "User will be used for the TR-181 schedules plugin"
    default "tr181_app"

config SAH_AMX_TR181_SCHEDULES_RUN_AS_GROUP
    string "Group will be used for the TR-181 schedules plugin"
    default "tr181_app"

endmenu

endif
```

## net_services/apps/tr069-connectionrequest/Config.in
```kconfig
menu "Select tr069-connectionrequest build options"
    depends on PACKAGE_tr069-connectionrequest

config TR069_CONNECTIONREQUEST_ORDER
    int "tr069-connectionrequest start up order"
    default 99

endmenu
```

## net_services/mods/mod-httpaccess-lighttpd/Config.in
```kconfig
config PACKAGE_mod-httpaccess-lighttpd
    tristate
    select SAH_MOD_HTTPACCESS_LIGHTTPD

if PACKAGE_mod-httpaccess-lighttpd

menu "Select mod-httpaccess-lighttpd build options"
    depends on PACKAGE_mod-httpaccess-lighttpd

config SAH_MOD_HTTPACCESS_LIGHTTPD
    bool "Build lighttpd's module for tr181-httpaccess plugin"
    default y

config SAH_MOD_HTTPACCESS_LIGHTTPD_FORCEFUL_TIMEOUT_SHUTDOWN
    int "Timeout in seconds before forcefully shutdown lighttpd (SIGKILL)"
    default 10
	help
	  This timeout start after graceful stop has been initiated (SIGINT). Value is in seconds and should be greater than server.graceful-shutdown-timeout. See config/lighttpd.template for more details.

endmenu

endif
```

## net_services/plugins/multisettings/tr181-schedules/Config.in
```kconfig
config PACKAGE_tr181-schedules
    tristate
    select SAH_AMX_TR181_SCHEDULES

if PACKAGE_tr181-schedules

menu "Select tr181-schedules build options"
    depends on PACKAGE_tr181-schedules

config SAH_AMX_TR181_SCHEDULES
    bool "Build TR-181 Schedules plugin"
    default y

config SAH_AMX_TR181_SCHEDULES_START_ORDER
    int "tr181 schedules plugin start up order"
    default 20

config SAH_AMX_TR181_SCHEDULES_STOP_ORDER
    int "tr181 schedules plugin shutdown order"
    default 80

config SAH_AMX_TR181_SCHEDULES_RUN_AS_USER
    string "User will be used for the TR-181 schedules plugin"
    default "tr181_app"

config SAH_AMX_TR181_SCHEDULES_RUN_AS_GROUP
    string "Group will be used for the TR-181 schedules plugin"
    default "tr181_app"

endmenu

endif
```

## net_services/plugins/tr181-cpu/Config.in
```kconfig
config PACKAGE_tr181-cpu
    tristate
    select SAH_AMX_TR181_CPU

if PACKAGE_tr181-cpu

menu "Select tr181-cpu build options"
    depends on PACKAGE_tr181-cpu

config SAH_AMX_TR181_CPU
    bool "Build a tr181 cpu"
    default y

config SAH_AMX_TR181_CPU_START_ORDER
    int "TR181 cpu plugin start up order"
    default 99

config SAH_AMX_TR181_CPU_STOP_ORDER
    int "TR181 cpu plugin shutdown order"
    default 1

config SAH_AMX_TR181_CPU_RUN_AS_USER
    string "User will be used for the tr181-cpu plugin"
    default "tr181_app"

config SAH_AMX_TR181_CPU_RUN_AS_GROUP
    string "Group will be used for the tr181-cpu plugin"
    default "tr181_app"

endmenu

endif
```

## net_services/plugins/tr181-dnssd/Config.in
```kconfig
config PACKAGE_tr181-dnssd
    tristate
    select SAH_AMX_TR181_DNSSD

if PACKAGE_tr181-dnssd

menu "Select tr181-dnssd build options"
    depends on PACKAGE_tr181-dnssd

config SAH_AMX_TR181_DNSSD
    bool "Build a tr181 compatible dns service discovery plugin"
    default y

config SAH_AMX_TR181_DNSSD_ORDER
    int "Start up order for the tr181 dns service discovery plugin"
    default 31

config SAH_AMX_TR181_DNSSD_RUN_AS_USER
    string "User will be used for the tr181-dnssd plugin"
    default "tr181_app"

config SAH_AMX_TR181_DNSSD_RUN_AS_GROUP
    string "Group will be used for the tr181-dnssd plugin"
    default "tr181_app"

endmenu

endif
```

## net_services/plugins/tr181-dynamicdns/Config.in
```kconfig
config PACKAGE_tr181-dynamicdns
    tristate
    select SAH_DYNAMIC_DNS

if PACKAGE_tr181-dynamicdns

menu "Select tr181-dynamicdns build options"
    depends on PACKAGE_tr181-dynamicdns

config SAH_DYNAMIC_DNS
    bool "Build the TR-181 Device.DynamicDNS"
    default y

config SAH_DYNAMIC_DNS_START_ORDER
    int "Init start up order for the the TR-181 Device.DynamicDNS plugin"
    default 25

config SAH_DYNAMIC_DNS_STOP_ORDER
    int "Init stop order for the the TR-181 Device.DynamicDNS plugin"
    default 75

config SAH_DYNAMIC_DNS_BACKUPRESTORE_ORDER
    int "DYNAMIC-DNS plugin backup restore order"
    default 10

config SAH_DYNAMIC_DNS_DEBUGINFO_ORDER
    int "DYNAMIC-DNS plugin debug info order"
    default 10

endmenu

endif
```

## net_services/plugins/tr181-flashmonitor/Config.in
```kconfig
config PACKAGE_tr181-flashmonitor
    tristate
    select SAH_AMX_TR181_FLASHMONITOR

if PACKAGE_tr181-flashmonitor

menu "Select tr181-flashmonitor build options"
    depends on PACKAGE_tr181-flashmonitor

config SAH_AMX_TR181_FLASHMONITOR
    bool "Build a flash monitor plugin"
    default y

config SAH_AMX_TR181_FLASHMONITOR_ORDER
    int "Start up order for the flash monitor plugin"
    default 99

config SAH_AMX_TR181_FLASHMONITOR_RUN_AS_USER
    string "User will be used for the flash monitor plugin"
    default "tr181_app"

config SAH_AMX_TR181_FLASHMONITOR_RUN_AS_GROUP
    string "Group will be used for the flash monitor plugin"
    default "tr181_app"

endmenu

endif
```

## net_services/plugins/tr181-ipdiagnostics/Config.in
```kconfig
config PACKAGE_tr181-ipdiagnostics
    tristate
    select SAH_IP_DIAGNOSTICS

if PACKAGE_tr181-ipdiagnostics

menu "Select tr181-ipdiagnostics build options"
    depends on PACKAGE_tr181-ipdiagnostics

config SAH_IP_DIAGNOSTICS
    bool "Build the TR-181 IP.Diagnostics"
    default y

config PRPL_IP_DIAGNOSTIC_UPLOAD_DOWNLOAD
    bool "Build the TR-181 Device.IP.Diagnostics.DownloadDiagnostics and Device.IP.Diagnostics.UploadDiagnostics"
    default y

endmenu

endif
```

## net_services/plugins/tr181-ipsec/Config.in
```kconfig
config PACKAGE_tr181-ipsec
    tristate
    select SAH_AMX_TR181_IPSEC

if PACKAGE_tr181-ipsec

menu "Select tr181-ipsec build options"
    depends on PACKAGE_tr181-ipsec

config SAH_AMX_TR181_IPSEC
    bool "Build tr181-ipsec plugin"
    default y

config SAH_AMX_TR181_IPSEC_START_ORDER
    int "start up order of tr181-ipsec plugin"
    default 84

config SAH_AMX_TR181_IPSEC_STOP_ORDER
    int "shutdown order of tr181-ipsec plugin"
    default 16

endmenu

endif
```

## net_services/plugins/tr181-mqtt/Config.in
```kconfig
config PACKAGE_tr181-mqtt
    tristate
    select SAH_AMX_TR181_MQTT

if PACKAGE_tr181-mqtt

menu "Select tr181-mqtt build options"
    depends on PACKAGE_tr181-mqtt

config SAH_AMX_TR181_MQTT
    bool "TR-181 compatible MQTT client"
    default y

config SAH_AMX_TR181_MQTT_ORDER
    int "TR-181 MQTT client plugin start up order"
    default 49

endmenu

endif
```

## net_services/plugins/tr181-powermanager/Config.in
```kconfig
config PACKAGE_tr181-powermanager
    tristate
    select SAH_AMX_TR181_POWERMANAGER

if PACKAGE_tr181-powermanager

menu "Select tr181-powermanager build options"
    depends on PACKAGE_tr181-powermanager

config SAH_AMX_TR181_POWERMANAGER
    bool "Build a tr181 compatible For Deep Standby"
    default y

config SAH_AMX_TR181_POWERMANAGER_START_ORDER
    int "tr181 powermanager plugin start up order"
    default 81

config SAH_AMX_TR181_POWERMANAGER_STOP_ORDER
    int "tr181 powermanager plugin shutdown order"
    default 19

endmenu

endif
```
