## appends/netmodel/Config.in
```kconfig
if PACKAGE_netmodel

menu "Select netmodel vendor-specific build options"
    depends on PACKAGE_netmodel

config SAH_AMX_NETMODEL_DIRECT_SOCKET
    bool "Enable the usage of direct socket communication via PCB"
    default n

endmenu

endif
```

## board_configuration/utilities/odl-generator/Config.in
```kconfig
config PACKAGE_odl-generator
    tristate
    select SAH_ODLGEN

if PACKAGE_odl-generator

menu "Select odl-generator build options"
    depends on PACKAGE_odl-generator

config SAH_ODLGEN
    bool "Build odlgen"
    default y

config SAH_ODLGEN_MULTIPLE_RUNLEVELS
    bool "Excecute runlevel specific scripts under /etc/runlevel.d at firstboot"
    default n

endmenu

endif
```

## datacollect/datacollect-agent/Config.in
```kconfig
config PACKAGE_datacollect-agent
    tristate
    select SAH_DATACOLLECT_AGENT

if PACKAGE_datacollect-agent

menu "Select datacollect-agent build options"
    depends on PACKAGE_datacollect-agent

config SAH_DATACOLLECT_AGENT
    bool "Build the DataCollect agent plugin"
    default y

config SAH_DATACOLLECT_AGENT_START_ORDER
    int "DataCollect agent plugin start up order"
    default 95

config SAH_DATACOLLECT_AGENT_STOP_ORDER
    string "DataCollect agent plugin shutdown order"
    default "05"

config SAH_DATACOLLECT_PERSIST_PATH
    string "Path where is stored configuration file and persistence file"
    default "/etc/config/datacollect/agent"

endmenu

endif
```

## debug/plugins/amx-faultmonitor/Config.in
```kconfig
config PACKAGE_amx-faultmonitor
    tristate
    select SAH_AMX_FAULTMONITOR

if PACKAGE_amx-faultmonitor

menu "Select amx-faultmonitor build options"
    depends on PACKAGE_amx-faultmonitor

config SAH_AMX_FAULTMONITOR
    bool "Build faultmonitor plugin"
    default y

config SAH_AMX_FAULTMONITOR_START_ORDER
    int "Faultmonitor plugin start up order"
    default 15

config SAH_AMX_FAULTMONITOR_STOP_ORDER
    int "Faultmonitor plugin shutdown order"
    default 89

config SAH_AMX_FAULTMONITOR_RUN_AS_USER
    string "User will be used for the amx-faultmonitor plugin"
    default "tr181_app"

config SAH_AMX_FAULTMONITOR_RUN_AS_GROUP
    string "Group will be used for the amx-faultmonitor plugin"
    default "tr181_app"

endmenu

endif
```

## debug/plugins/oopsmonitor/Config.in
```kconfig
config PACKAGE_oopsmonitor
    tristate
    select SAH_AMX_OOPSMONITOR

if PACKAGE_oopsmonitor

menu "Select oopsmonitor build options"
    depends on PACKAGE_oopsmonitor

config SAH_AMX_OOPSMONITOR
    bool "Build the oopsmonitor plugin"
    default y

config SAH_AMX_OOPSMONITOR_ORDER
    int "Start up order"
    default 99

config SAH_AMX_OOPSMONITOR_RUN_AS_USER
    string "User will be used for the OOPSMONITOR plugin"
    default "tr181_app"

config SAH_AMX_OOPSMONITOR_RUN_AS_GROUP
    string "Group will be used for the OOPSMONITOR plugin"
    default "tr181_app"

config SAH_AMX_OOPSMONITOR_DEFAULT_PARSING
    bool "Enable default parsing"
    default y

endmenu

endif
```

## display/tr181-display/Config.in
```kconfig
config PACKAGE_tr181-display
    tristate
    select TR181_DISPLAY

if PACKAGE_tr181-display

menu "Select tr181-display build options"
    depends on PACKAGE_tr181-display

config TR181_DISPLAY
    bool "Build a TR-181 compatible display manager"
    default y

config TR181_DISPLAY_ORDER
    int "Display start up order"
    default 41

config TR181_DISPLAY_SCREEN_TYPE
    string "Display type for the attached screen(s)"
    default "LCD"

endmenu

endif
```

## gmap/apps/gmap-mod-self/Config.in
```kconfig
config PACKAGE_gmap-mod-self
    tristate
    select SAH_SERVICES_GMAP-SELF

if PACKAGE_gmap-mod-self

menu "Select gmap-mod-self build options"
    depends on PACKAGE_gmap-mod-self

config SAH_SERVICES_GMAP-SELF
    bool "Build GMAP SELF"
    default y

endmenu

endif
```

## gmap/apps/gmap-server/Config.in
```kconfig
config PACKAGE_gmap-server
    tristate
    select SAH_AMX_GMAP_SERVER

if PACKAGE_gmap-server

menu "Select gmap-server build options"
    depends on PACKAGE_gmap-server

config SAH_AMX_GMAP_SERVER
    bool "Build gMap server"
    default y

config SAH_AMX_GMAP_SERVER_ORDER
    int "gMap server plugin startup order"
    default 71

endmenu

endif
```

## gmap/configs/gmap-mibs-common/Config.in
```kconfig
config PACKAGE_gmap-mibs-common
    tristate
    select SAH_SERVICES_GMAP-MIBS-COMMON

if PACKAGE_gmap-mibs-common

menu "Select gmap-mibs-common build options"
    depends on PACKAGE_gmap-mibs-common

config SAH_SERVICES_GMAP-MIBS-COMMON
    bool "Include gmap mibs"
    default y

config SAH_SERVICES_GMAP-MIBS-COMMON_WAN-ACCESS
    bool "Enable the WanAccess mib"
    default y

config SAH_SERVICES_GMAP-MIBS-COMMON_PRIORITY
    bool "Enable the Priority mib"
    default y

config SAH_SERVICES_GMAP-MIBS-COMMON_LOCATION
    bool "Enable the Location mib"
    default y

config SAH_SERVICES_GMAP-MIBS-COMMON_INFORMATION
    bool "Enable the Information mib"
    default y

endmenu

endif
```

## gmap/libs/libgmap-client/Config.in
```kconfig
config PACKAGE_libgmap-client
    tristate
    select SAH_LIB_GMAP-CLIENT

if PACKAGE_libgmap-client

menu "Select libgmap-client build options"
    depends on PACKAGE_libgmap-client

config SAH_LIB_GMAP-CLIENT
    bool "Build libgmap-client"
    default y

config SAH_LIB_GMAP-CLIENT_SOP
    bool "Build the libgmap-client library for SOP"
    default n

endmenu

endif
```

## imagegenerator/imagegenerator/Config.in
```kconfig
config IMAGEGENERATOR_BOARD
	string "Board to build images for"
	default ""
	help
	  The board name is used to retrieve config files and build images
```

## initramfs-generator/Config.in
```kconfig
config PACKAGE_initramfs-generator
    tristate
    select INITRAMFS_GENERATOR

if PACKAGE_initramfs-generator

menu "Select initramfs-generator build options"
    depends on PACKAGE_initramfs-generator

config INITRAMFS_GENERATOR
    bool "Build initramfs-generator"
    default y
	help
	  Provide tools to build a pivoting initramfs.
    depends on KERNEL_DEVTMPFS && BUSYBOX_CONFIG_MODPROBE && BUSYBOX_CONFIG_MODPROBE_SMALL && BUSYBOX_CONFIG_FEATURE_MODPROBE_SMALL_CHECK_ALREADY_LOADED && PACKAGE_kmod-dm && PACKAGE_blkid && PACKAGE_blockdev && PACKAGE_lvm2

config INITRAMFS_GENERATOR_DEBUG
    bool "debug mode"
    default n
	help
	  Debugging mode. Will enable more traces, and a fail during startup will drop
	  the user in a rescue shell instead of rebooting.

config INITRAMFS_GENERATOR_DEMO
    bool "use demo values and files"
    default n
	help
	  A bunch of options of initramfs generator require specific files at runtime
	  to work (for instance, configuration files or keys). If they are not found
	  in the initramfs, the boot may fail.
	  With this option, demo files will be copied to initramfs as needed, making
	  sure any selected feature may proceed as possible.
	  This option is intended as a debugging and bringup tool: you can use the demo
	  files to avoid building a bunch of values for development, and avoid doubts
	  related to values.

choice
    prompt "Choose the flash type: eMMC or NAND"
    default INITRAMFS_GENERATOR_FLASH_TYPE_EMMC

config INITRAMFS_GENERATOR_FLASH_TYPE_EMMC
    bool "Select eMMC as flash type"

config INITRAMFS_GENERATOR_FLASH_TYPE_NAND
    bool "Select NAND as flash type"

endchoice

config INITRAMFS_GENERATOR_KRS
    bool "KRS key injection support"
    default n
	help
	  This flag adds support for kernel KRS (Key Retention Service) keys injection.
	  It means that, initramfs will be able to take a list of keys, and add them
	  to the KRS, making them available to userspace without exposing them.
	  The keys list should be located in the initramfs, and define the list of
	  keys to be added and how.
	  More information is available in the matching init script.
    depends on PACKAGE_keyctl && KERNEL_KEYS

config INITRAMFS_GENERATOR_KEY_DERIVATION
    bool "HKDF key derivation support"
    default n
	help
	  This flag adds support for keys derivation in initramfs, using HKDF and
	  openssl-kdf.
	  The derivation(s) list and specifications should be located in the initramfs,
	  provided by the builder.
	  More information is available in the matching init script, and demo values.
    depends on PACKAGE_openssl-util

config INITRAMFS_GENERATOR_ROOTFS_FIT
    bool "support rootfs in a FIT"
    default y
	help
	  Support rootfs packaged in a FIT (see https://fitspec.osfw.foundation/).
	  Note that, your FIT needs to be built with data out of tree, with
	  absolute position (see --external and --position for mkimage).
    depends on BUSYBOX_CONFIG_HEXDUMP && PACKAGE_fdt-utils

config INITRAMFS_GENERATOR_ROOTFS_SIG_PRELOAD
    bool "support rootfs pre-load signature"
    default y
	help
	  Support rootfs signature with U-boot pre-load method (see
	  https://github.com/u-boot/u-boot/blob/master/tools/binman/etype/pre_load.py).
    depends on BUSYBOX_CONFIG_HEXDUMP && BUSYBOX_CONFIG_SHA256SUM && BUSYBOX_CONFIG_DD && PACKAGE_openssl-util

config INITRAMFS_GENERATOR_ROOTFS_SIG_PRELOAD_MANDATORY
    bool "make pre-load signature mandatory on rootfs FIT"
    default n
	help
	  With this option, rootfs SHOULD be signed with U-boot pre-load signature. If
	  the corresponding magic is not found, instead of skipping signature verification,
	  the boot will fail this image.
    depends on INITRAMFS_GENERATOR_ROOTFS_SIG_PRELOAD

config INITRAMFS_GENERATOR_ROOTFS_DMVERITY
    bool "set up dm-verity on rootfs"
    default n
	help
	  Enable dm-verity setup routines, on rootfs device.
	  The verity target parameters will be taken or deduced from the rootfs
	  FIT metadata, which should contain appropriate data.
	  Note that, your rootfs will be readonly if you select this option.
    depends on INITRAMFS_GENERATOR_ROOTFS_FIT

config INITRAMFS_GENERATOR_ROOTFS_DMCRYPT
    bool "set up dm-crypt on rootfs"
    default n
	help
	  Enable dm-crypt setup routines, on rootfs device.
	  The crypt target requires a key and parameters, which should be provided
	  to init scripts.
	  You can find an example as a demo key and parameters, using KRS.
	  Note that, enabling this flag without KRS support will disable the demo files.

config INITRAMFS_GENERATOR_NONROOT_DMCRYPT
    bool "support ciphering of non-root partitions"
    default n
	help
	  Enable dm-crypt setup routines, on non-root devices.
	  The devices and crypt targets should be defined by a specifications file,
	  provided in the initramfs.
	  You can find an example with demo keys and parameters, using KRS.
	  Note that, enabling this flag without KRS support will disable the demo files.

endmenu

endif
```

## mcastd/kmods/mcastd-core/Config.in
```kconfig
# Copyright (C) 2023 Soft At Home

menu "Configuration"
    depends on PACKAGE_mcastd-core

config MCASTD_DEBUG
    bool "Build mcastd with debug loggings"
    default n

config MCASTD_NICE
	int "Nice value of mcastd's main kthread"
	default -18

config MCASTD_ACCESS_CONTROL
	bool "Multicast access control (whitelist, max nr of groups, ...)"
	default n
	help
	  If set, mcastd controls whether IGMP reports are admitted/dropped
	  depending on a whitelist, and settings specifying the maximum number
	  of multicast groups, the maximum overall multicast bandwidth, the
	  imputed bandwidth per group, and the maximum rate of upstream IGMP
	  traffic.

	  There is no support for access control of IPv6 multicast traffic.

	  This setting should be enabled for HGWs with a PON WAN interface.

endmenu
```

## mcastd/kmods/mcastd-routing/Config.in
```kconfig
config PACKAGE_kmod-mcastd-routing
    tristate
    select MCASTD_ROUTING

if PACKAGE_kmod-mcastd-routing

menu "Select kmod-mcastd-routing build options"
    depends on PACKAGE_kmod-mcastd-routing

config MCASTD_ROUTING
    bool "Build mcastd routing kernel module"
    default y

config MCASTD_ROUTING_DEBUG
    bool "Build mcastd routing with debug loggings"
    default n

endmenu

endif
```

## mcastd/plugins/tr181-mcastd/Config.in
```kconfig
config PACKAGE_tr181-mcastd
    tristate
    select SAH_AMX_TR181_MCASTD_CORE_PLUGIN

if PACKAGE_tr181-mcastd

menu "Select tr181-mcastd build options"
    depends on PACKAGE_tr181-mcastd

config SAH_AMX_TR181_MCASTD_CORE_PLUGIN
    bool "Build mcastd's user space app"
    default y

config SAH_AMX_TR181_MCASTD_CORE_PLUGIN_ORDER
    int "mcastd startup order"
    default 22

config SAH_AMX_TR181_MCASTD_CORE_PLUGIN_QUERY_MCAST_IPTV_INTF
    bool "Find out ifindex of mcast-iptv interface"
    default n
	help
	  If set, the plugin runs an extra NeMo query for an IPTV WAN
	  interface to find out which interface below that IPTV WAN interface
	  has the flag mcast-iptv. Set this option if the IPTV WAN interface
	  is a bridge, and the MCASTD accelerator should only create an
	  acceleration rule for the interface in the bridge which has the
	  mcast-iptv flag set. The plugin passes the result from the NeMo
	  query to kernel space.
	  This option is added for following use case. Some projects put 2
	  interfaces in the IPTV WAN bridge, one with the flag mcast-iptv, and
	  one with the flag vod-iptv. But the vod-iptv interface is for VOD
	  which is unicast. So there's no reason to create a MC acceleration
	  rule for the vod-iptv interface.

config SAH_AMX_TR181_MCASTD_CORE_PLUGIN_RUN_AS_USER
    string "User will be used for the tr181-mcastd plugin"
    default "tr181_app"

config SAH_AMX_TR181_MCASTD_CORE_PLUGIN_RUN_AS_GROUP
    string "Group will be used for the tr181-mcastd plugin"
    default "tr181_app"

endmenu

endif
```

## mfgdata/libs/libmfg/Config.in
```kconfig
config PACKAGE_libmfg
    tristate
    select SAH_LIB_MFG

if PACKAGE_libmfg

menu "Select libmfg build options"
    depends on PACKAGE_libmfg

config SAH_LIB_MFG
    bool "build SAH_LIB_MFG component"
    default y

config SAH_LIB_MFG_RO_PART_FILE
    string "MFG data read-only partition file or ubi volume name"
    default "/etc/rip_ro"
	help
	  MFG data read-only file.
	  May be a ubi device and volume name separated by ':' (e.g. ubi1:factoryparams),
	  or a path to any other file (e.g. /etc/rip_ro, /dev/ubi0_65)

config SAH_LIB_MFG_RW_PART_FILE
    string "Optional MFG data read-write, standard linux file"
    default ""
	help
	  Even if global signature is enabled it is ignored for the RW MFG.

config SAH_LIB_MFG_SECURE_MFG_SUPPORT
    bool "Support MFG data field encryption and/or signature that requires decryption by mfg_decrypt"
    default n

config SAH_LIB_MFG_PUBLIC_PEM_FILE
    string "Public key PEM file use to verify the signature of the SMFG data"
    default ""
    depends on SAH_LIB_MFG_SECURE_MFG_SUPPORT

config SAH_LIB_MFG_GLOBAL_SIGNATURE
    bool "Support (and require) a U-boot style signature on the MFG DTB"
    default n

config SAH_LIB_MFG_GLOBAL_SIGNATURE_PUBLIC_PEM_FILE
    string "Path to the public key PEM file (within config dir) used to verify the MFG DTB signature"
    default "/security/mfg.pem"
    depends on SAH_LIB_MFG_GLOBAL_SIGNATURE

config SAH_LIB_MFG_GLOBAL_SIGNATURE_PADDING_MODE
    string "Padding mode for global MFG signature"
    default "pss"
    depends on SAH_LIB_MFG_GLOBAL_SIGNATURE

config SAH_LIB_MFG_SECURE_MFG_KERNEL_KEYRING_SUPPORT
    bool "Support field encryption with the keys provided by the kernel keyring."
    default n
	help
	  MFG contains secured fields. To decrypt those fields, keys from the kernel keyring are used.

config SAH_LIB_MFG_SECURE_MFG_KERNEL_KEYRING_KEY_NAME
    string "The name of the keyring key that should be used"
    default "prplmfg:0"
    depends on SAH_LIB_MFG_SECURE_MFG_KERNEL_KEYRING_SUPPORT

config SAH_LIB_MFG_SECURE_MFG_KERNEL_KEYRING_IV_FILE
    string "The location of the iv key hex file"
    default "/security/Kmfg-aes-iv.hex"
    depends on SAH_LIB_MFG_SECURE_MFG_KERNEL_KEYRING_SUPPORT

endmenu

endif
```
