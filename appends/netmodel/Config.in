## net_core/plugins/dhcpv4-manager/Config.in
```kconfig
config PACKAGE_dhcpv4-manager
    tristate
    select SAH_SERVICES_AMX-DHCPV4-MANAGER

if PACKAGE_dhcpv4-manager

menu "Select dhcpv4-manager build options"
    depends on PACKAGE_dhcpv4-manager

config SAH_SERVICES_AMX-DHCPV4-MANAGER
    bool "TR-181 Device.DHCPv4.Server datamodel implementation"
    default y

config SAH_SERVICES_AMX-DHCPV4-MANAGER_RUN_AS_USER
    string "User will be used for the dhcpv4-manager plugin"
    default "tr181_app"

config SAH_SERVICES_AMX-DHCPV4-MANAGER_RUN_AS_GROUP
    string "Group will be used for the dhcpv4-manager plugin"
    default "tr181_app"

endmenu

endif
```

## net_core/plugins/ip-manager/Config.in
```kconfig
config PACKAGE_ip-manager
    tristate
    select SAH_AMX_TR181_IP

if PACKAGE_ip-manager

menu "Select ip-manager build options"
    depends on PACKAGE_ip-manager

config SAH_AMX_TR181_IP
    bool "TR-181 Device.IP datamodel implementation"
    default y

config SAH_AMX_TR181_IP_RUN_AS_USER
    string "User will be used for the IP-MANAGER plugin"
    default "tr181_app"

config SAH_AMX_TR181_IP_RUN_AS_GROUP
    string "Group will be used for the IP-MANAGER plugin"
    default "tr181_app"

config SAH_AMX_TR181_IP_START_ORDER
    int "Init start up order for the IP-MANAGER plugin"
    default 21

config SAH_AMX_TR181_IP_STOP_ORDER
    int "Init stop order for the IP-MANAGER plugin"
    default 10

endmenu

endif
```

## net_core/plugins/netdev-plugin/Config.in
```kconfig
config PACKAGE_netdev-plugin
    tristate
    select SAH_AMX_NETDEV

if PACKAGE_netdev-plugin

menu "Select netdev-plugin build options"
    depends on PACKAGE_netdev-plugin

config SAH_AMX_NETDEV
    bool "Build NetDev"
    default y

config SAH_AMX_NETDEV_64_BITS_NETWORK_STATISTICS
    bool "Use 64 bit network statistics instead of 32 bit"
    default y

config SAH_AMX_NETDEV_RUN_AS_USER
    string "User will be used for the NETDEV plugin"
    default "tr181_app"

config SAH_AMX_NETDEV_RUN_AS_GROUP
    string "Group will be used for the NETDEV plugin"
    default "tr181_app"

config SAH_AMX_NETDEV_START_ORDER
    int "Init start up order for the NETDEV plugin"
    default 20

config SAH_AMX_NETDEV_STOP_ORDER
    int "Init stop order for the NETDEV plugin"
    default 10

endmenu

endif
```

## net_core/plugins/routing-manager/Config.in
```kconfig
config PACKAGE_routing-manager
    tristate
    select SAH_AMX_TR181_ROUTING

if PACKAGE_routing-manager

menu "Select routing-manager build options"
    depends on PACKAGE_routing-manager

config SAH_AMX_TR181_ROUTING
    bool "TR-181 Routing"
    default y

config SAH_AMX_TR181_ROUTING_RUN_AS_USER
    string "User will be used for the ROUTING-MANAGER plugin"
    default "tr181_app"

config SAH_AMX_TR181_ROUTING_RUN_AS_GROUP
    string "Group will be used for the ROUTING-MANAGER plugin"
    default "tr181_app"

config SAH_AMX_TR181_ROUTING_ROUTER_DISCOVERY
    bool "Enable TR-181 Routing router discovery functionality"
    default n

config SAH_AMX_TR181_ROUTING_PASSTHROUGH_TABLE_ID
    int "Passthrough policy routing table ID (Device.Routing.Router.2)"
    depends on SAH_AMX_TR181_ROUTING
    default 100
    range 1 254
    help
      Linux routing table number for IP passthrough (Router instance Alias Passthrough).
      Sets Routing.Router.2 Name and ID at build time. Default 100.
      tr181-passthrough reads this via RouterReference.

config SAH_AMX_TR181_ROUTING_START_ORDER
    int "Start up order"
    default 30

config SAH_AMX_TR181_ROUTING_STOP_ORDER
    int "Stop order"
    default 10

endmenu

endif
```

## net_core/plugins/tr181-conmon/Config.in
```kconfig
config PACKAGE_tr181-conmon
    tristate
    select SAH_AMX_TR181_CONMON

if PACKAGE_tr181-conmon

menu "Select tr181-conmon build options"
    depends on PACKAGE_tr181-conmon

config SAH_AMX_TR181_CONMON
    bool "Build TR-181 Connection Monitor plugin"
    default y

config SAH_AMX_TR181_CONMON_START_ORDER
    int "Start up order for the tr181-conmon plugin"
    default 98

config SAH_AMX_TR181_CONMON_STOP_ORDER
    int "Shutdown order for the tr181-conmon plugin"
    default 78

config SAH_AMX_TR181_CONMON_RUN_AS_USER
    string "User will be used for the tr181-conmon plugin"
    default "tr181_app"

config SAH_AMX_TR181_CONMON_RUN_AS_GROUP
    string "Group will be used for the tr181-conmon plugin"
    default "tr181_app"

endmenu

endif
```

## net_core/plugins/tr181-dhcpv4client/Config.in
```kconfig
config PACKAGE_tr181-dhcpv4client
    tristate
    select SAH_AMX_TR181_DHCPV4CLIENT

if PACKAGE_tr181-dhcpv4client

menu "Select tr181-dhcpv4client build options"
    depends on PACKAGE_tr181-dhcpv4client

config SAH_AMX_TR181_DHCPV4CLIENT
    bool "Build TR-181 compatible DHCPv4 client"
    default y

config SAH_AMX_TR181_DHCPV4CLIENT_RUN_AS_USER
    string "User will be used for the TR-181 DHCPV4CLIENT plugin"
    default "tr181_app"

config SAH_AMX_TR181_DHCPV4CLIENT_RUN_AS_GROUP
    string "Group will be used for the TR-181 DHCPV4CLIENT plugin"
    default "tr181_app"

config SAH_AMX_TR181_DHCPV4CLIENT_SENTOPTION_125
    string "Vendor-Identifying Vendor-Specific Information Option to sent in DHCP requests"
    default ""

config SAH_AMX_TR181_DHCPV4CLIENT_START_ORDER
    int "Init start up order for the TR-181 DHCPV4CLIENT plugin"
    default 27

config SAH_AMX_TR181_DHCPV4CLIENT_STOP_ORDER
    int "Init stop order for the TR-181 DHCPV4CLIENT plugin"
    default 75

endmenu

endif
```

## net_core/plugins/tr181-dhcpv6client/Config.in
```kconfig
config PACKAGE_tr181-dhcpv6client
    tristate
    select SAH_AMX_TR181_DHCPV6CLIENT

if PACKAGE_tr181-dhcpv6client

menu "Select tr181-dhcpv6client build options"
    depends on PACKAGE_tr181-dhcpv6client

config SAH_AMX_TR181_DHCPV6CLIENT
    bool "Build TR-181 compatible DHCPv6 client"
    default y
    select ODHCP6C_ENABLE_UBUS

config SAH_AMX_TR181_DHCPV6CLIENT_RUN_AS_USER
    string "User will be used for the tr181-dhcpv6client plugin"
    default "tr181_app"

config SAH_AMX_TR181_DHCPV6CLIENT_RUN_AS_GROUP
    string "Group will be used for the tr181-dhcpv6client plugin"
    default "tr181_app"

config SAH_AMX_TR181_DHCPV6CLIENT_SENTOPTION_17
    string "Vendor-Identifying Vendor-Specific Information Option to sent in DHCP requests"
    default ""

config SAH_AMX_TR181_DHCPV6CLIENT_START_ORDER
    int "Init start up order for the tr181-dhcpv6client plugin"
    default 25

config SAH_AMX_TR181_DHCPV6CLIENT_STOP_ORDER
    int "Init stop order for the tr181-dhcpv6client plugin"
    default 75

endmenu

endif
```

## net_core/plugins/tr181-dns/Config.in
```kconfig
config PACKAGE_tr181-dns
    tristate
    select SAH_AMX_TR181_DNS

if PACKAGE_tr181-dns

menu "Select tr181-dns build options"
    depends on PACKAGE_tr181-dns

config SAH_AMX_TR181_DNS
    bool "Build a tr181 compatible dns plugin"
    default y

config SAH_AMX_TR181_DNS_ORDER
    int "Start up order for the tr181 dns plugin"
    default 30

config SAH_AMX_TR181_DNS_CELLULAR
    bool "Add the default cellular DNS.Relay.Forwarding instances"
    default y

config SAH_AMX_TR181_DNS_RUN_AS_USER
    string "User will be used for the tr181-dns plugin"
    default "tr181_app"

config SAH_AMX_TR181_DNS_RUN_AS_GROUP
    string "Group will be used for the tr181-dns plugin"
    default "tr181_app"

endmenu

endif
```

## net_core/plugins/tr181-dslite/Config.in
```kconfig
config PACKAGE_tr181-dslite
    tristate
    select SAH_AMX_TR181_DSLITE

if PACKAGE_tr181-dslite

menu "Select tr181-dslite build options"
    depends on PACKAGE_tr181-dslite

config SAH_AMX_TR181_DSLITE
    bool "Build tr181 compatible dslite plugin"
    default y

config SAH_AMX_TR181_DSLITE_ORDER
    int "Start up order for the tr181 dslite plugin"
    default 42

config SAH_AMX_TR181_DSLITE_CARES_RPATH
    bool "Enable linking and setting rpath to /opt/prplos"
    default n

config SAH_AMX_TR181_DSLITE_RUN_AS_USER
    string "User will be used for the tr181-dslite plugin"
    default "tr181_app"

config SAH_AMX_TR181_DSLITE_RUN_AS_GROUP
    string "Group will be used for the tr181-dslite plugin"
    default "tr181_app"

endmenu

endif
```
